## config/boards/shields/bb_blackpill/Kconfig.defconfig
```kconfig
# Copyright (c) 2022 The ZMK Contributors
# SPDX-License-Identifier: MIT

if SHIELD_BB_BLACKPILL

config ZMK_KEYBOARD_NAME
    default "BB Blackpill"

endif
```

## config/boards/shields/bb_blackpill/Kconfig.shield
```kconfig
# Copyright (c) 2022 The ZMK Contributors
# SPDX-License-Identifier: MIT

config SHIELD_BB_BLACKPILL
	def_bool $(shields_list_contains,bb_blackpill)
```
